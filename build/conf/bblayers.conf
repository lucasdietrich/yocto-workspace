## build/conf/bblayers.conf
```bitbake
# POKY_BBLAYERS_CONF_VERSION is increased each time build/conf/bblayers.conf
# changes incompatibly
POKY_BBLAYERS_CONF_VERSION = "2"

BBPATH = "${TOPDIR}"
BBFILES ?= ""

BBLAYERS ?= " \
  /home/lucas/yocto-tmp/poky/meta \
  /home/lucas/yocto-tmp/poky/meta-poky \
  /home/lucas/yocto-tmp/poky/meta-yocto-bsp \
  /home/lucas/yocto/meta-openembedded/meta-oe \
  /home/lucas/yocto/meta-openembedded/meta-python \
  /home/lucas/yocto/meta-openembedded/meta-networking \
  /home/lucas/yocto/meta-st-stm32mp \
  /home/lucas/yocto/meta-bootlinlabs \
  /home/lucas/yocto/meta-rust \
  "
```
